## arch/arm/mach-imx/imx8m/Kconfig
```kconfig
if ARCH_IMX8M

config IMX8M
	bool
	select GICV3 if ARMV8_PSCI
	select HAS_CAAM
	select ROM_UNIFIED_SECTIONS
	select ARMV8_CRYPTO

config IMX8MQ
	bool
	select IMX8M
	select CLK_IMX8MQ

config IMX8MM
	bool
	select IMX8M

config IMX8MN
	bool
	select IMX8M

config IMX8MP
	bool
	select IMX8M

config SYS_SOC
	default "imx8m"

config SYS_HAS_ARMV8_SECURE_BASE
	bool "Enable secure address for PSCI image"
	depends on ARMV8_PSCI
	help
	  PSCI image can be re-located to secure RAM.
	  If enabled, please also define the value for ARMV8_SECURE_BASE,
	  for i.MX8M, it could be some address in OCRAM.

choice
	prompt "NXP i.MX8M board select"
	optional



config TARGET_1U0025_VILYA
	bool "Consolinno 1U0025_VILYA EVK Board"
	select BINMAN
	select IMX8MM
	select SUPPORT_SPL
	select IMX8M_LPDDR4

endchoice


source "board/consolinno/1u0025_vilya/Kconfig"

endif
```

## board/consolinno/1u0025/Kconfig
```kconfig
if TARGET_CONSOLINNO_1U0025

config SYS_BOARD
	string
	default "1u0025"

config SYS_VENDOR
	string
	default "consolinno"

config SYS_CONFIG_NAME
	string
	default "consolinno-1u0025"

endif
```

## board/consolinno/1u0025_vilya/Kconfig
```kconfig
if TARGET_1U0025_VILYA

config SYS_BOARD
	default "1u0025_vilya"

config SYS_VENDOR
	default "consolinno"

config SYS_CONFIG_NAME
	default "1u0025_vilya"

config IMX_CONFIG
	default "board/consolinno/1u0025_vilya/1u0025_vilya.cfg"

endif
```
